## esp32/components/muse/Kconfig
```kconfig
# Copyright (c) Meta Platforms, Inc. and affiliates.
#
# Licensed under the Apache License, Version 2.0 (the "License");
# you may not use this file except in compliance with the License.
# You may obtain a copy of the License at
#
#     http://www.apache.org/licenses/LICENSE-2.0
#
# Unless required by applicable law or agreed to in writing, software
# distributed under the License is distributed on an "AS IS" BASIS,
# WITHOUT WARRANTIES OR CONDITIONS OF ANY KIND, either express or implied.
# See the License for the specific language governing permissions and
# limitations under the License.

menu "Muse"

    choice MUSE_BOARD
        prompt "Board with the full UI"
        default MUSE_BOARD_NONE
        help
            The UI is the voice companion on boards with a screen: an
            animated avatar, push-to-talk chat, settings, and battery
            handling. It runs beside Home Link, which owns Wi-Fi, BLE
            pairing, credentials and OTA. Pick the board it runs on, or none
            for a Link without a display.

        config MUSE_BOARD_NONE
            bool "None (Home Link without a display)"

        config MUSE_BOARD_WAVESHARE_S3_175C
            bool "Waveshare ESP32-S3-Touch-AMOLED-1.75C"
            depends on IDF_TARGET_ESP32S3

        config MUSE_BOARD_WAVESHARE_S3_175
            bool "Waveshare ESP32-S3-Touch-AMOLED-1.75 (not the 1.75C)"
            depends on IDF_TARGET_ESP32S3

        config MUSE_BOARD_OSTB_ECHOEAR_2ST
            bool "OSTB EchoEar-2ST (360px round touch LCD, experimental)"
            depends on IDF_TARGET_ESP32S3

        config MUSE_BOARD_WAVESHARE_S3_216
            bool "Waveshare ESP32-S3-Touch-AMOLED-2.16"
            depends on IDF_TARGET_ESP32S3

        config MUSE_BOARD_WAVESHARE_S3_185C
            bool "Waveshare ESP32-S3-Touch-LCD-1.85C"
            depends on IDF_TARGET_ESP32S3

        config MUSE_BOARD_ESP_MOSAICO
            bool "Espressif ESP-Mosaico (ESP32-S31)"
            depends on IDF_TARGET_ESP32S31

        config MUSE_BOARD_AIPI
            bool "AIPI Lite (ESP32-S3, two buttons, no touch)"
            depends on IDF_TARGET_ESP32S3

        config MUSE_BOARD_ESPRESSIF_BOX_3
            bool "Espressif ESP32-S3-BOX-3 (320x240 touch LCD, speaker and microphones)"
            depends on IDF_TARGET_ESP32S3

        config MUSE_BOARD_WAVESHARE_C6_18
            bool "Waveshare ESP32-C6-Touch-AMOLED-1.8"
            depends on IDF_TARGET_ESP32C6

        config MUSE_BOARD_WAVESHARE_C6_206
            bool "Waveshare ESP32-C6-Touch-AMOLED-2.06"
            depends on IDF_TARGET_ESP32C6

        config MUSE_BOARD_SENSECAP_WATCHER
            bool "Seeed SenseCAP Watcher (ESP32-S3, round touch LCD, wheel)"
            depends on IDF_TARGET_ESP32S3

        config MUSE_BOARD_M5STACK_CARDPUTER_ADV
            bool "M5Stack Cardputer ADV (ESP32-S3, keyboard, no PSRAM)"
            depends on IDF_TARGET_ESP32S3

        config MUSE_BOARD_M5STACK_STICKS3
            bool "M5Stack StickS3 (ESP32-S3, two buttons, no touch)"
            depends on IDF_TARGET_ESP32S3

        config MUSE_BOARD_M5STACK_STICKC_PLUS2
            bool "M5Stack StickC Plus2 (ESP32, two buttons, no touch)"
            depends on IDF_TARGET_ESP32

        config MUSE_BOARD_M5STACK_STOPWATCH
            bool "M5Stack StopWatch (ESP32-S3, round touch AMOLED)"
            depends on IDF_TARGET_ESP32S3

        config MUSE_BOARD_M5STACK_CORES3
            bool "M5Stack CoreS3 (ESP32-S3, 320x240 touch LCD, speaker and microphones)"
            depends on IDF_TARGET_ESP32S3

        config MUSE_BOARD_M5STACK_CORE2
            bool "M5Stack Core2 v1.0 (ESP32, touch LCD, touch-strip talk)"
            depends on IDF_TARGET_ESP32
        config MUSE_BOARD_FNK0104B
            bool "Freenove FNK0104B (ESP32-S3, 240x320 touch LCD, ES8311 speaker and mic)"
            depends on IDF_TARGET_ESP32S3
        config MUSE_BOARD_GUITION_JC3248W535
            bool "Guition JC3248W535 (ESP32-S3, 3.5\" 320x480 touch LCD, speaker)"
            depends on IDF_TARGET_ESP32S3

        config MUSE_BOARD_WAVESHARE_S3_LCD7
            bool "Waveshare ESP32-S3-Touch-LCD-7 (800x480 touch LCD, no audio)"
            depends on IDF_TARGET_ESP32S3
        config MUSE_BOARD_WAVESHARE_S3_LCD128
            bool "Waveshare ESP32-S3-Touch-LCD-1.28 (240x240 round touch LCD, no audio)"
            depends on IDF_TARGET_ESP32S3
        config MUSE_BOARD_VN_S3_183
            bool "VN ESP32-S3 board (1.83\" 284x240 NV3023 LCD, ES8311 and ES7210)"
            depends on IDF_TARGET_ESP32S3
        config MUSE_BOARD_AI_PASSPORT
            bool "FoloToy AI Passport (ESP32-C3, three buttons, no touch)"
            depends on IDF_TARGET_ESP32C3
    endchoice

    config MUSE_ENABLED
        bool
        default y if !MUSE_BOARD_NONE

    # Always defined, unlike the target-dependent board options, so
    # idf_component.yml rules can select each board's managed components.
    config MUSE_BOARD_ID
        string
        default "waveshare_s3_175c" if MUSE_BOARD_WAVESHARE_S3_175C
        default "waveshare_s3_175" if MUSE_BOARD_WAVESHARE_S3_175
        default "ostb_echoear_2st" if MUSE_BOARD_OSTB_ECHOEAR_2ST
        default "waveshare_s3_216" if MUSE_BOARD_WAVESHARE_S3_216
        default "waveshare_s3_185c" if MUSE_BOARD_WAVESHARE_S3_185C
        default "esp_mosaico" if MUSE_BOARD_ESP_MOSAICO
        default "aipi" if MUSE_BOARD_AIPI
        default "espressif_box_3" if MUSE_BOARD_ESPRESSIF_BOX_3
        default "waveshare_c6_18" if MUSE_BOARD_WAVESHARE_C6_18
        default "waveshare_c6_206" if MUSE_BOARD_WAVESHARE_C6_206
        default "sensecap_watcher" if MUSE_BOARD_SENSECAP_WATCHER
        default "m5stack_sticks3" if MUSE_BOARD_M5STACK_STICKS3
        default "m5stack_stickc_plus2" if MUSE_BOARD_M5STACK_STICKC_PLUS2
        default "m5stack_cardputer_adv" if MUSE_BOARD_M5STACK_CARDPUTER_ADV
        default "m5stack_stopwatch" if MUSE_BOARD_M5STACK_STOPWATCH
        default "m5stack_cores3" if MUSE_BOARD_M5STACK_CORES3
        default "m5stack_core2" if MUSE_BOARD_M5STACK_CORE2
        default "fnk0104b" if MUSE_BOARD_FNK0104B
        default "guition_jc3248w535" if MUSE_BOARD_GUITION_JC3248W535
        default "waveshare_s3_lcd7" if MUSE_BOARD_WAVESHARE_S3_LCD7
        default "waveshare_s3_lcd128" if MUSE_BOARD_WAVESHARE_S3_LCD128
        default "vn_s3_183" if MUSE_BOARD_VN_S3_183
        default "ai_passport" if MUSE_BOARD_AI_PASSPORT
        default "none"

    # The Muse tools' serial port: the console UART behind the board's USB
    # bridge, where the chip's own USB Serial/JTAG isn't wired to a connector
    # (the Watcher's USB-C goes to a CH342) or the chip has none.
    config MUSE_CONSOLE_UART
        bool
        default y if MUSE_BOARD_SENSECAP_WATCHER || MUSE_BOARD_WAVESHARE_S3_LCD7 || MUSE_BOARD_WAVESHARE_S3_LCD128 || !SOC_USB_SERIAL_JTAG_SUPPORTED

    # A board overlay can raise this for a quiet speaker.
    config MUSE_DEFAULT_VOLUME
        int "Speaker volume until one is chosen in settings (percent)"
        range 0 100
        default 70

    config MUSE_POWER_TEST
        bool "Isolated board BSP power-characterization firmware"
        # Boards implementing boards/muse_power_test_board.h; extend this list
        # only after the new board's diagnostic hooks and matrix pass tests.
        depends on (MUSE_BOARD_SENSECAP_WATCHER) && PM_ENABLE && FREERTOS_USE_TICKLESS_IDLE
        default n
        help
            DIAGNOSTIC ONLY: bypass Home Link and the Muse UI/voice application
            at app_main. USB UART arms a timed autonomous VBUS-free BSP-load
            sweep. No credentials, production NVS, BLE provisioning or OTA.
            Results are retained in RAM/RTC until read back after USB reconnect.
            This characterizes isolated BSP loads, NOT production power.
            Optional camera support is not required and unsupported matrix
            features are explicitly skipped. Never enable in a release profile.

    config MUSE_WATCHER_CAMERA
        bool "SenseCAP Watcher camera capture and live preview"
        depends on MUSE_BOARD_SENSECAP_WATCHER && SPIRAM
        default n
        help
            Enable the camera.capture Home Link command and the wheel
            double-click camera preview. Camera buffers and tasks consume
            memory and preview decoding shares CPU time with voice and Link.
            Leave disabled to build without camera support.

    config MUSE_CJK_FONT
        bool "Show Chinese and Japanese in captions"
        depends on MUSE_ENABLED
        default n
        help
            Captions fall back to GNU Unifont's 16x16 bitmaps for CJK
            punctuation, kana, the CJK Unified Ideographs and fullwidth
            forms that the ASCII caption font lacks. Small screens, whose
            captions are two lines of 8 px text, show a reply with CJK in it
            one 16 px line at a time. Takes about 850 KB of flash and no RAM.
            Without it those characters show as boxes. Hangul isn't
            included.

    config MUSE_CLOCK
        bool "Show a clock on the idle screen"
        depends on MUSE_ENABLED
        default n
        help
            Once the network sets the time over SNTP, show the current time
            in HH:MM under the status label on the idle screen. Until it
            syncs, and when it can't, it reads --:--. The time is queried once
            at startup; the device's clock ticks it along from there.

    config MUSE_WATCH_FACE
        bool "Show the swipe-right watch face (neon clock tile)"
        depends on MUSE_ENABLED
        default y
        help
            On touch boards, add a neon analog "watch face" tile one swipe to
            the right of Muse (see muse_clock_ui.c). Turn this off to keep the
            idle screen on Muse and settings only; the watch-face code is still
            built in, just not wired into the tile view. Disabling it also saves
            the hand-animation work the tile would do while it is visible.

    config MUSE_CLOCK_TZ
        string "Clock timezone (POSIX TZ string)"
        depends on MUSE_CLOCK
        default "CST-8"
        help
            A POSIX TZ string for the local time shown. "CST-8" is UTC+8
            (China/Singapore). "EST5EDT,M3.2.0,M11.1.0" is US Eastern with
            DST, "GMT0BST,M3.5.0/1,M10.5.0" is UK time. Note POSIX signs are
            inverted: the number is hours west of UTC, so -8 means UTC+8.

    config MUSE_JC3248W535_MIC_GPIO
        int "JC3248W535: GPIO for an external I2S mic's data (SD) line"
        depends on MUSE_BOARD_GUITION_JC3248W535
        range -1 48
        default -1
        help
            The board has a speaker amp but no microphone. Wire an I2S MEMS
            mic such as an INMP441 to the speaker's clocks (SCK to GPIO42, WS
            to GPIO2), L/R to GND, power to 3.3 V, and its SD line to a free
            GPIO, and set that GPIO here. -1 leaves push-to-talk recording
            silence.

    config MUSE_STATIC_BUFFERS_IN_PSRAM
        bool "Keep the avatar's and audio's static buffers in PSRAM"
        depends on MUSE_ENABLED && SPIRAM_ALLOW_BSS_SEG_EXTERNAL_MEMORY
        default n
        help
            Places the zero-initialized statics of the avatar renderer
            (muse_pixel.c: its frame, mask and lookup tables) and the audio
            path (muse_audio.c: the I2S staging and chirp buffers), about
            17 KB, in PSRAM instead of internal RAM (linker.lf). Only the
            CPU touches them: the avatar is scaled into LVGL's draw buffer,
            and the I2S driver copies to and from its own DMA buffers. Turn
            it on where internal RAM is short, as the SenseCAP Watcher does
            to pay for the CPU's light-sleep retention memory, which it
            takes at boot and keeps.

    config MUSE_CHAT_ROUTELLM
        bool "Use Abacus.ai RouteLLM (ChatLLM) instead of Muse's servers"
        depends on MUSE_ENABLED && SPIRAM
        default n
        help
            Replaces Muse's voice session with a direct HTTPS call to the
            OpenAI-compatible RouteLLM API (routellm.abacus.ai). Each
            push-to-talk turn records audio, posts it to an audio-capable
            model, and shows the text reply as captions. Needs PSRAM. In this
            mode the gadget does not use Muse's agent, the home-network tunnel,
            or Muse-app pairing for chat. Set the API key over serial with
            ">chatllm_key=..." (stored in NVS); get one from abacus.ai
            (ChatLLM > RouteLLM API).

    config MUSE_ROUTELLM_BASE_URL
        string "RouteLLM API base URL"
        depends on MUSE_CHAT_ROUTELLM
        default "https://routellm.abacus.ai/v1"
        help
            The OpenAI-compatible base URL. Self-serve ChatLLM accounts use
            https://routellm.abacus.ai/v1; enterprise workspaces use
            https://<workspace>.abacus.ai/v1.

    config MUSE_ROUTELLM_MODEL
        string "RouteLLM model for voice turns"
        depends on MUSE_CHAT_ROUTELLM
        default "gpt-audio-mini"
        help
            An audio-input-capable model, such as gpt-audio-mini or
            gpt-audio-1.5. The recorded voice note is sent to it and its text
            answer is shown.

    config MUSE_ROUTELLM_MAX_SECONDS
        int "Longest voice note to record (seconds)"
        depends on MUSE_CHAT_ROUTELLM
        range 3 15
        default 12
        help
            Caps how much 16 kHz mono audio one push-to-talk turn records and
            uploads. Each second is about 32 KB of PSRAM before base64.

    config MUSE_ROUTELLM_KEY
        string "RouteLLM API key baked into the firmware (optional)"
        depends on MUSE_CHAT_ROUTELLM
        default ""
        help
            Optional ChatLLM/RouteLLM API key compiled into the firmware so the
            gadget works on first boot without the serial command. A key set
            over serial (">chatllm_key=...", stored in NVS) takes precedence.
            Leaving this empty keeps the secret out of the firmware image;
            prefer that and set the key over serial.

    config MUSE_ROUTELLM_SPEAK
        bool "Speak RouteLLM replies aloud (ChatLLM text-to-speech)"
        depends on MUSE_CHAT_ROUTELLM
        default n
        help
            Ask the model for spoken audio alongside the text reply and play
            it through the speaker. The reply's audio (MP3) is decoded on the
            device and the caption follows the speech. The speaker toggle on
            the face or in settings still mutes it, in which case the reply is
            shown as text only. Costs extra tokens and download per turn.

    config MUSE_ROUTELLM_VOICE
        string "Voice for spoken replies"
        depends on MUSE_ROUTELLM_SPEAK
        default "alloy"
        help
            The OpenAI-style voice name sent as audio.voice, such as alloy,
            echo, fable, onyx, nova or shimmer.

    config MUSE_HATCH
        bool "Muse's own voice session"
        depends on MUSE_ENABLED && !MUSE_CHAT_ROUTELLM
        default y if SPIRAM
        default n
        help
            Push-to-talk turns go over a voice session of Muse's own, to the
            VM Home Link is paired with or one set up on the device with a
            device token. Replies are text, shown as captions; start_tts in
            muse_chat_session.cpp is where a TTS API of your own can speak
            them. Needs PSRAM. Without it, voice notes go over Home Link's own
            session to its paired VM and replies are shown as text.

    config MUSE_HATCH_COMPACT_BUFFERS
        bool "Smaller voice session buffers, for 2 MB of PSRAM"
        depends on MUSE_HATCH
        default n
        help
            The voice session keeps about 830 KB of audio buffers in PSRAM:
            512 KB of reply speech, 8 s of mic backlog and 2 s of decoded
            audio. With 2 MB of PSRAM that leaves too little once Home Link
            is connected, and a chat turn runs out of memory. This keeps
            128 KB of speech, 2 s of mic backlog and 1 s of decoded audio
            (about 220 KB), which still covers a push-to-talk turn. Board
            overlays with 2 MB of PSRAM turn it on.

endmenu
```
